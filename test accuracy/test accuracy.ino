#define   TOTAL_SAMPLE_NUM 100
#define MAX_FEATURE_NUM 64
const int8_t rawData[TOTAL_SAMPLE_NUM][64] PROGMEM= {
{1,3,8,5,-6,-2,13,3,2,14,8,10,8,-9,-22,-4,3,1,1,-2,3,1,4,0,1,-2,-1,1,2,1,1,1,1,2,2,0,1,2,2,1,1,0,1,2,-1,0,2,1,1,2,1,1,1,0,1,1,0,0,1,1,1,1,1,1},
{1,9,11,6,1,-9,11,17,14,27,25,-4,-49,-26,8,10,11,7,-11,3,2,10,-4,-3,-10,5,1,3,-2,1,1,2,2,-2,0,0,2,2,2,0,-1,-1,1,1,-2,1,0,3,1,1,0,0,0,1,0,0,1,0,1,1,1,1,1,0},
{1,-7,18,8,14,7,2,16,42,22,-1,-64,-33,8,8,20,5,-3,1,1,14,-4,-3,-13,5,2,1,2,0,0,4,2,-3,0,0,2,2,1,1,-2,-1,2,0,-1,1,0,2,1,1,-2,0,-1,1,-1,0,0,0,0,0,1,1,0,0,0},
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{0,-1,-9,3,2,9,16,24,12,22,4,-6,-12,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8,7}};


#include <arduinoFFT.h>

float features[MAX_FEATURE_NUM];
double featuresForFFT[MAX_FEATURE_NUM];
int randomClass;

// int sumPos[MAX_FEATURE_NUM];
// int sumNeg[MAX_FEATURE_NUM];

// float uP = 0;
// float uN = 0;

// byte posCount = 0;
// byte negCount = 0;

byte dataset[80][MAX_FEATURE_NUM];
float weights[MAX_FEATURE_NUM];

float score;

// float tNeg;
// float tPos;

float Bias;
int correctOutput = 0;

arduinoFFT fft;

void buildDataset(int featureNum=MAX_FEATURE_NUM){
  // Serial.print("building the dataset");
  for (int j = 0; j < 80; j++) {
    // take the class value as it is
    dataset[j][0] = pgm_read_byte(&rawData[j][0]);

    for (int i = 0; i < featureNum; i++) {
      featuresForFFT[i] = pgm_read_byte(&rawData[j][i+1]); //index 0 is used to store ta class
    }

// perform fft ans store the features
    fft.Windowing(featuresForFFT, featureNum, FFT_WIN_TYP_HAMMING, FFT_FORWARD);
    for (int i = 0; i < featureNum; i++) {

      dataset[j][i + 1] = min(abs(featuresForFFT[i]) * 100, 255);
    }
}}

void train(int featureNum=MAX_FEATURE_NUM, int testSamplesStartingIndex=80) {
  // Serial.print(", training");
int sumPos[MAX_FEATURE_NUM] = {0};

int sumNeg[MAX_FEATURE_NUM] = {0};

float uP = 0;
float uN = 0;

byte posCount = 0;
byte negCount = 0;

float tNeg = 0;
float tPos = 0;  
  for (byte i = 0; i < testSamplesStartingIndex; i++)
  {
    // count N_pos and N_neg
    if (dataset[i][0] == 1) posCount++;
    if (dataset[i][0] == 0) negCount++;

    //    eq 3 and 4
    for (byte j = 1; j < featureNum; j++)
    {

      if (dataset[i][0] == 1)
      {
        sumPos[j] += dataset[i][j];
      }

      if (dataset[i][0] == 0)
      {
        sumNeg[j] += dataset[i][j];
      }
    }
    }

    
  //  eq 5, calculate the weights
  for (byte j = 1; j < featureNum; j++)
  {
    uP = sumPos[j] / posCount;
    uN = sumNeg[j] / negCount;
    if (uP + uN == 0) weights[j] = 0;
    else
      weights[j] = (uP - uN) / (uP + uN);
  }


  //eq 7 and 8
  for (byte ii = 0; ii < testSamplesStartingIndex; ii++)
  {
    score = 0;
    for (byte j = 1; j < featureNum; j++)
    {
      score += weights[j] * dataset[ii][j];
    }
    (dataset[ii][0] == 0) ? tNeg += score : tPos += score;

  }

  //  eq 9
  Bias = (negCount * (tPos / posCount) + posCount * (tNeg / negCount)) / (negCount + posCount);
  // Serial.print("bias");
  // Serial.println(Bias);
  }

void test(int featureNum=MAX_FEATURE_NUM, int testSamplesStartingIndex=80){
Serial.print("test accurecy ");
correctOutput = 0;
for(int testN = 80; testN < TOTAL_SAMPLE_NUM; testN++){
score = 0;
  for (int i = 0; i < featureNum; i++) {
    featuresForFFT[i] = pgm_read_byte(&rawData[testN][i+1]);
  }

  fft.Windowing(featuresForFFT, featureNum, FFT_WIN_TYP_HAMMING, FFT_FORWARD);
  for (int i = 0; i < featureNum; i++) {
    score += weights[i] * min(abs(featuresForFFT[i]) * 100, 255);
  }

  if((score > Bias && pgm_read_byte(&rawData[testN][0]) == 1) || (score < Bias && pgm_read_byte(&rawData[testN][0]) == 0)) 
  correctOutput++;
}

Serial.print(correctOutput*100/20);  
Serial.println("%");
}

void trainAndTest(int featureNum=MAX_FEATURE_NUM, int testSamplesStartingIndex=80){
  for(int _featureNum=2; _featureNum <=64; _featureNum*=2){
    Serial.println();
    Serial.print("For feature number ");
    Serial.println(_featureNum);
  buildDataset(_featureNum);
  train(_featureNum);
  test(_featureNum);
  }
}

void setup() {
  Serial.begin(9600);
  trainAndTest();
}

void loop(){}